/dts-v1/;
#include "stm32mp157c-dk2.dts"

/ {
        model = "Stm mpu Adnan Qt5";
};

&i2c5 {
    status = "okay";


    mpu6050@68 {
        compatible = "invensense,mpu6050";
        reg = <0x68>;
        interrupt-parent = <&gpioe>;
        interrupts = <1 IRQ_TYPE_EDGE_RISING>; /* PE1*/
    };

};
